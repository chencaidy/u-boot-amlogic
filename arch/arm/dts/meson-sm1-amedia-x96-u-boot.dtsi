// SPDX-License-Identifier: (GPL-2.0+ OR MIT)
/*
 * Copyright (c) 2020 Chen Caidy <chen@caidy.cc>
 */

#include "meson-sm1-u-boot.dtsi"

&ethmac {
	snps,reset-gpio = <&gpio GPIOZ_15 (GPIO_ACTIVE_LOW | GPIO_OPEN_DRAIN)>;
	snps,reset-delays-us = <0 10000 1000000>;
	snps,reset-active-low;
};

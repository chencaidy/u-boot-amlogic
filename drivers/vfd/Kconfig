## drivers/vfd/Kconfig
```kconfig
menu "VFD Support"

config OPENVFD
	bool "Enable OpenVFD support"
	depends on DM_GPIO
	help
	  Many boards have LEDs which can be used to signal status or alerts.
	  U-Boot provides a uclass API to implement this feature. LED drivers
	  can provide access to board-specific LEDs. Use of the device tree
	  for configuration is encouraged.

endmenu
```
